## boards/shields/keeb60_3d/Kconfig.defconfig
```kconfig
if SHIELD_KEEB60_3D

config ZMK_KEYBOARD_NAME
    default "keeb60_3d"

endif # SHIELD_KEEB60_3D
```

## boards/shields/numpad3d/Kconfig.defconfig
```kconfig
if SHIELD_NUMPAD3D

config ZMK_KEYBOARD_NAME
    default "numpad3d"

endif # SHIELD_NUMPAD3D
```
